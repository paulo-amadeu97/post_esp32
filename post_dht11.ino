#include <WiFi.h>
#include <HTTPClient.h>
#include <DHT.h>
#include <Wire.h>
#include <Adafruit_GFX.h>
#include <Adafruit_SSD1306.h>
#include <SPI.h>
#include <MFRC522.h>
#include <WebServer.h>
#include <ArduinoJson.h>

//WIFI
const char *ssid = "REDE_TEST";
const char *password = "robotica01";
bool wifiStatus = false;
IPAddress local_IP(192, 168, 0, 30);
IPAddress gateway(192, 168, 0, 1);
IPAddress subnet(255, 255, 255, 0);

//DHT
#define DHTPIN 26
#define DHTTYPE DHT11


//OLED
#define SCREEN_WIDTH 128
#define SCREEN_HEIGHT 64
#define SCREEN_ADDRESS 0x3C

//RFID
#define SDA_PIN 5
#define RST_PIN 2

Adafruit_SSD1306 display(SCREEN_WIDTH, SCREEN_HEIGHT, &Wire);
DHT dht(DHTPIN, DHTTYPE);
MFRC522 rfid(SDA_PIN, RST_PIN);

//LOGO DE ADS
const unsigned char adsLogo[] PROGMEM = {
	0xff, 0xff, 0xff, 0xff, 0xff, 0xff, 0xff, 0xff, 0xff, 0xff, 0xff, 0xff, 0xff, 0xff, 0xff, 0xff, 
	0xff, 0xff, 0xff, 0xff, 0xff, 0xff, 0xff, 0xff, 0xff, 0xff, 0xff, 0xff, 0xff, 0xff, 0xff, 0xff, 
	0xff, 0xff, 0xff, 0xff, 0xff, 0xff, 0xff, 0xff, 0xff, 0xff, 0xff, 0xff, 0xff, 0xff, 0xff, 0xff, 
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	0xff, 0xff, 0xff, 0xff, 0xff, 0xff, 0xff, 0xff, 0xff, 0xff, 0xff, 0xff, 0xff, 0xff, 0xff, 0xff
};
//PORTA E BUZZER
#define DOOR 25
#define DOOR_CLOSE 33
#define BOTON 4
#define BUZZER_PIN 32

//URLs DA API
const char* serverUrlStData = "http://192.168.0.25:8080/statedata/";
const char* serverUrlAccessData = "http://192.168.0.25:8080/access/";
const char* postUrl = "http://192.168.0.25:8080/auth/register/rfid/esp/";

//CONTROLE DE TEMPO E BEEP
unsigned long previousMillis = 0;
unsigned long previousMillisRfid = 0;
unsigned long previousMillisLock = 0;
unsigned long doorOpenTime = 0;
const long interval = 30000; 
const long intervalRfid = 50;
bool doorOpen = false;

//FUNÇÕES DE INICIALIZAÇÃO
void initDisplay();
void handleButtonPress();
void checkDoorTimeout();
void openDoor();
void closeDoor();
void initWiFi();
void sendSensorData();
void reconnectWiFiIfNeeded();

WebServer server(80);

void setup() {
  Serial.begin(9600);
  pinMode(DOOR, OUTPUT);
  pinMode(DOOR_CLOSE, OUTPUT);
  pinMode(BOTON, INPUT);
  digitalWrite(DOOR, HIGH);
  pinMode(BUZZER_PIN, OUTPUT);

  initDisplay();
  dht.begin();
  initWiFi();
  setupServer();

  SPI.begin();
  rfid.PCD_Init();
}

void loop() {
  handleButtonPress();
  checkDoorTimeout();
  sendSensorData();
  reconnectWiFiIfNeeded();
  monRfid();
  processRequest();
}

//INICIALIZAÇÃO DO OLED
void initDisplay() {
  if (!display.begin(SSD1306_SWITCHCAPVCC, SCREEN_ADDRESS)) {
    Serial.println("Falha ao inicializar a tela OLED");
    while (1);
  }
  display.clearDisplay();
  display.setTextSize(2);
  display.setTextColor(SSD1306_WHITE);
  display.setCursor(0, 0);
  display.drawBitmap(0, 0, adsLogo, SCREEN_WIDTH, SCREEN_HEIGHT, SSD1306_WHITE);
  display.display();
  delay(1000);
  printData();
}

//CONECTAR WIFI
void initWiFi() {
  if (!WiFi.config(local_IP, gateway, subnet)) {
    Serial.println("Falha ao configurar IP estático.");
  }

  WiFi.begin(ssid, password);
  while (WiFi.status() != WL_CONNECTED) {
    handleButtonPress();
    checkDoorTimeout();
    printData();
    delay(1000);
    Serial.println("Conectando ao WiFi...");
  }
  Serial.println("WiFi conectado!");
  Serial.print("Endereço IP: ");
  Serial.println(WiFi.localIP());
  wifiStatus = true;
  printData();
}


void beepOk() {
  tone(BUZZER_PIN, 1000, 300);
}


void beepErro(){
  tone(BUZZER_PIN, 100, 1000);
}


void handleButtonPress() {
  if (digitalRead(BOTON) == HIGH && !doorOpen) {
    openDoor();
    printData();
    beepOk();
  }
}


void checkDoorTimeout() {
  if (doorOpen && millis() - doorOpenTime >= 5000) {
    closeDoor();
    printData();
  }
}

bool getDoorStatus(){
  if(digitalRead(DOOR) == HIGH){
    return false;
  }
  return true;
}

void displayData(float temperature, float humidity, float tmpOrv){
  String wifi = "";
  display.clearDisplay();
  display.setCursor(0, 0);
  display.setTextSize(1);
  display.print("Temp: ");
  display.print(temperature);
  display.println(" C");
  display.print("Umi: ");
  display.print(humidity);
  display.println(" %");
  display.print("Temp_Orv:");
  display.print(tmpOrv);
  display.println(" C");
  display.println();
  display.setTextSize(2);
  if(getDoorStatus()){
    display.println("ABERTO");
  }else{
    display.println("FECHADO");
  }
  if(wifiStatus){
    wifi = "conectado!";
  } else {
    wifi = "desconectado!";
  }
  display.setTextSize(1);
  display.println();
  display.println(wifi);
  display.display();
}

void printData(){
  float temperature = dht.readTemperature();
  float humidity = dht.readHumidity();
  float tmpOrv = (237.7 * (((17.27 * temperature) / (237.7 + temperature)) + 
                  log(humidity / 100))) / (17.27 - (((17.27 * temperature) / 
                  (237.7 + temperature)) + log(humidity / 100)));

  if (isnan(temperature) || isnan(humidity)) {
    Serial.println("Falha ao ler do sensor DHT!");
    return;
  }
  displayData(temperature, humidity, tmpOrv);
}

void sendSensorData() {
  unsigned long currentMillis = millis();
  if (currentMillis - previousMillis >= interval) {
    previousMillis = currentMillis;
    
    float temperature = dht.readTemperature();
    float humidity = dht.readHumidity();
    float tmpOrv = (237.7 * (((17.27 * temperature) / (237.7 + temperature)) + 
                  log(humidity / 100))) / (17.27 - (((17.27 * temperature) / 
                  (237.7 + temperature)) + log(humidity / 100)));

    if (isnan(temperature) || isnan(humidity)) {
      Serial.println("Falha ao ler do sensor DHT!");
      return;
    }

    displayData(temperature, humidity, tmpOrv);

    if (WiFi.status() == WL_CONNECTED) {
      HTTPClient http;
      http.begin(serverUrlStData);
      http.addHeader("Content-Type", "application/json");

      String jsonData = "{\"temperature\": " + String(temperature) + ", \"humidity\": " + String(humidity) + "}";
      int httpResponseCode = http.POST(jsonData);

      Serial.println(jsonData);
      if (httpResponseCode > 0) {
        String response = http.getString();
        Serial.println("Resposta do servidor: " + response);
      } else {
        Serial.println("Erro na requisição POST: " + String(httpResponseCode));
      }
      http.end();
    } else {
      Serial.println("Erro de conexão WiFi");
      wifiStatus = false;
    }
  }
}

bool sendLogData(String url) {
  if (WiFi.status() == WL_CONNECTED) {
      String rfid = readRfid();
      HTTPClient http;
      http.begin(url);
      http.addHeader("Content-Type", "application/json");

      String jsonData = "{\"rfid\": \"" + rfid + "\"}";
      int httpResponseCode = http.POST(jsonData);

      Serial.println(jsonData);
      if (httpResponseCode > 0) {
        String response = http.getString();
        Serial.println("Resposta do servidor: " + response);

        return (httpResponseCode >= 200 && httpResponseCode < 300);
      } else {
        display.clearDisplay();
        display.setTextSize(2);
        display.setCursor(16, 24);
        display.println("NEGADO!");
        display.display();
        Serial.println("Erro na requisição POST: " + String(httpResponseCode));
        return false;
      }
      http.end();
  } else {
    Serial.println("Erro de conexão WiFi");
    wifiStatus = false;
    return false;
  }
}

void openDoor() {
  Serial.println("Porta aberta");
  digitalWrite(DOOR, LOW);
  digitalWrite(DOOR_CLOSE, HIGH);
  doorOpen = true;
  doorOpenTime = millis();
}

void closeDoor() {
  Serial.println("Porta fechada");
  digitalWrite(DOOR, HIGH);
  digitalWrite(DOOR_CLOSE, LOW);
  doorOpen = false;
}

void reconnectWiFiIfNeeded() {
  if (WiFi.status() != WL_CONNECTED) {
    WiFi.status();
    Serial.println("Desconectado do WiFi, tentando reconectar...");
    WiFi.disconnect();
    wifiStatus = false;
    initWiFi();
  }
}

String readRfid(){
  String rfidData = "";
  for (byte i = 0; i < rfid.uid.size; i++) {
    if (rfid.uid.uidByte[i] < 0x10) {
      rfidData += "0";
    }
    rfidData += String(rfid.uid.uidByte[i], HEX);
  }
  rfid.PICC_HaltA();
  return rfidData;
}

void monRfid(){
  unsigned long currentMillis = millis();
  if (currentMillis - previousMillisRfid >= intervalRfid) {
    previousMillisRfid = currentMillis;

    if (!rfid.PICC_IsNewCardPresent() || !rfid.PICC_ReadCardSerial()) {
    return;
    }
    if(sendLogData(serverUrlAccessData)){
      openDoor();
      printData();
      beepOk();
    } else {
      float temperature = dht.readTemperature();
      float humidity = dht.readHumidity();
      float tmpOrv = (237.7 * (((17.27 * temperature) / (237.7 + temperature)) + 
                    log(humidity / 100))) / (17.27 - (((17.27 * temperature) / 
                    (237.7 + temperature)) + log(humidity / 100)));

      if (isnan(temperature) || isnan(humidity)) {
        Serial.println("Falha ao ler do sensor DHT!");
        return;
      }
      beepErro();
      display.clearDisplay();
      display.setCursor(0, 0);
      display.setTextSize(1);
      display.print("Temp: ");
      display.print(temperature);
      display.println(" C");
      display.print("Umi: ");
      display.print(humidity);
      display.println(" %");
      display.print("Temp_Orv:");
      display.print(tmpOrv);
      display.println(" C");
      display.println();
      display.setTextSize(2);
      display.println("NEGADO");
      display.display();
      unsigned long currentMillisLock = millis();
      if (currentMillisLock - previousMillisLock >= 1000) {
        previousMillisLock = currentMillisLock;
        printData();
      }
    }
  }
}

void setupServer() {
  server.on("/email/", HTTP_POST, processRequest);
  server.begin();
  Serial.println("Servidor iniciado e aguardando requisições POST em /email/");
}

void processRequest() {
  server.handleClient();
  if (server.hasArg("plain")) {
    String json = server.arg("plain");
    Serial.println("JSON recebido: " + json);

    StaticJsonDocument<200> doc;
    DeserializationError error = deserializeJson(doc, json);

    if (!error) {
      String email = doc["email"];
      Serial.println("Email recebido: " + email);
      server.send(200, "text/plain", "OK");

      display.clearDisplay();
      display.setCursor(0, 0);
      display.setTextSize(2);
      display.println("APROXIME");
      display.println("A TAG");
      display.display();

      unsigned long previousMillis = millis();
      String rfidTag = "";
      bool cardDetected = false;

      while ((millis() - previousMillis <= 30000) && !cardDetected) {
        if (rfid.PICC_IsNewCardPresent() && rfid.PICC_ReadCardSerial()) {
          rfidTag = readRfid();
          sendEmailAndRfid(email, rfidTag);
          cardDetected = true;
          beepOk();
        }
      }

      if (!cardDetected) {
        display.clearDisplay();
        display.setCursor(0, 0);
        display.setTextSize(2);
        display.println("NENHUM CARTAO");
        display.println("DETECTADO!");
        display.display();
        Serial.println("Nenhum cartão detectado no tempo limite.");
        beepErro();
        delay(2000);
      }
      ESP.restart();
    } else {
      Serial.println("Erro JSON: " + String(error.c_str()));
    }
  }
}

void sendEmailAndRfid(String email, String rfid) {
  if(WiFi.status() == WL_CONNECTED) {
    HTTPClient http;
    http.begin(postUrl);
    http.addHeader("Content-Type", "application/json");

    String jsonPayload = "{\"email\": \"" + email + "\", \"rfid\": \"" + rfid + "\"}";

    Serial.println(jsonPayload);

    int httpResponseCode = http.POST(jsonPayload);
    
    if (httpResponseCode > 0) {
      String response = http.getString();
      Serial.println("Resposta do servidor: " + response);
    } else {
      Serial.println("Erro ao enviar POST: " + String(httpResponseCode));
    }
    http.end();
  } else {
    Serial.println("Erro: Não conectado ao WiFi");
    wifiStatus = false;
  }
}
